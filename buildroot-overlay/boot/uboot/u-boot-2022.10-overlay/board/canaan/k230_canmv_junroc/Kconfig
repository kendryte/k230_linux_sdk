## buildroot-overlay/boot/uboot/u-boot-2022.10-overlay/board/canaan/k230_canmv_junroc/Kconfig
```kconfig
if TARGET_K230_CANMV_JUNROC

config SYS_CPU
	default "k230"

config SYS_VENDOR
    default "canaan"

config SYS_BOARD
    default "k230_canmv_junroc"

config SYS_CONFIG_NAME
    default "k230_evb"


config BOARD_SPECIFIC_OPTIONS # dummy
	def_bool y
	select RISCV_THEAD
choice
	prompt "ddr typy freq"
    default CANMV_JUNROC_LPDDR4_2667

config CANMV_JUNROC_LPDDR3_2133
	bool  2133
config CANMV_JUNROC_LPDDR3_1600
	bool  1600
config CANMV_JUNROC_LPDDR3_800
	bool 800
config CANMV_JUNROC_LPDDR4_2667
	bool LP4_2667
config CANMV_JUNROC_LPDDR4_3200
	bool LP4_3200

config CANMV_01_LPDDR4_1600_WITHOUT_ODT
	bool "canmv  LP4_1600 WITHOUT ODT,"
	help
		"CANMV V3,lushanpai,01studio"
endchoice
endif
```

## buildroot-overlay/boot/uboot/u-boot-2022.10-overlay/board/canaan/k230_canmv_mrt/Kconfig
```kconfig
if TARGET_K230_CANMV_MRT

config SYS_CPU
	default "k230"

config SYS_VENDOR
    default "canaan"

config SYS_BOARD
    default "k230_canmv_mrt"

config SYS_CONFIG_NAME
    default "k230_evb"


config BOARD_SPECIFIC_OPTIONS # dummy
	def_bool y
	select RISCV_THEAD
choice
	prompt "ddr typy freq"
	default CANMV_MRT_LPDDR4_2667

config CANMV_MRT_LPDDR4_2667
	bool LP4_2667
config CANMV_MRT_LPDDR4_3200
	bool LP4_3200

config CANMV_MRT_LPDDR4_1600_WITHOUT_ODT
	bool "canmv mrt LP4_1600 WITHOUT ODT,"
	help
		"CANMV MRT"
endchoice
endif
```

## buildroot-overlay/configs/k230d_canmv_ilp32_defconfig
```kconfig
BR2_riscv=y
BR2_RISCV_ISA_RVC=y
BR2_RISCV_ISA_RVV=y
BR2_RISCV_32=y
BR2_TOOLCHAIN_EXTERNAL=y
BR2_TOOLCHAIN_EXTERNAL_CUSTOM=y
BR2_TOOLCHAIN_EXTERNAL_PATH="/opt/toolchain/Xuantie-900-gcc-linux-6.6.0-glibc-x86_64-V3.0.2/"
BR2_TOOLCHAIN_EXTERNAL_CUSTOM_PREFIX="riscv64-unknown-linux-gnu"
BR2_TOOLCHAIN_EXTERNAL_HEADERS_6_6=y
BR2_TOOLCHAIN_EXTERNAL_CUSTOM_GLIBC=y
# BR2_TOOLCHAIN_EXTERNAL_INET_RPC is not set
BR2_TOOLCHAIN_EXTERNAL_CXX=y
BR2_TOOLCHAIN_EXTERNAL_FORTRAN=y
BR2_TOOLCHAIN_EXTERNAL_OPENMP=y
BR2_TARGET_OPTIMIZATION="-mcpu=c908v"
BR2_DL_DIR="$(TOPDIR)/../../dl"
BR2_SSP_REGULAR=y
BR2_FORTIFY_SOURCE_NONE=y
BR2_SYSTEM_DHCP="eth0"
BR2_ROOTFS_OVERLAY="board/canaan/k230-soc/rootfs_overlay"
BR2_ROOTFS_POST_BUILD_SCRIPT="board/canaan/k230-soc/post-build.sh"
BR2_ROOTFS_POST_IMAGE_SCRIPT="board/canaan/k230-soc/post-image.sh"
BR2_LINUX_KERNEL=y
BR2_LINUX_KERNEL_CUSTOM_GIT=y
BR2_LINUX_KERNEL_CUSTOM_REPO_URL="https://github.com/ruyisdk/linux-xuantie-kernel.git"
BR2_LINUX_KERNEL_CUSTOM_REPO_VERSION="7d4e1f444f461dbe3833bd99a4640e7b6c2cd529"
BR2_LINUX_KERNEL_DEFCONFIG="k230"
BR2_LINUX_KERNEL_DTS_SUPPORT=y
BR2_LINUX_KERNEL_INTREE_DTS_NAME="canaan/k230d-canmv"
BR2_PACKAGE_LINUX_ILP32=y
BR2_PACKAGE_AUDIO_DEMO=y
BR2_PACKAGE_LIB_RTSPSERVER=y
BR2_PACKAGE_MVX_PLAYER=y
BR2_PACKAGE_CAMERA_RTSP_DEMO=y
BR2_PACKAGE_WEBRTC=y
BR2_PACKAGE_CAMERA_WEBRTC_DEMO=y
BR2_PACKAGE_AUDIO_REC_PLAY=y
BR2_PACKAGE_VG_LITE_DEMOS=y
BR2_PACKAGE_VO_INIT=y
BR2_PACKAGE_BUSYBOX_CONFIG_FRAGMENT_FILES="board/canaan/k230-soc/fragment/busybox.fragment"
BR2_PACKAGE_FIO=y
BR2_PACKAGE_E2FSPROGS=y
BR2_PACKAGE_E2FSPROGS_RESIZE2FS=y
BR2_PACKAGE_PARTED=y
BR2_PACKAGE_UMTPRD=y
BR2_PACKAGE_FREETYPE=y
BR2_PACKAGE_LIBDRM_INSTALL_TESTS=y
BR2_PACKAGE_LIBGPIOD2=y
BR2_PACKAGE_LIBGPIOD2_TOOLS=y
BR2_PACKAGE_LIVE555=y
BR2_PACKAGE_IPERF3=y
BR2_PACKAGE_ANDROID_TOOLS=y
BR2_TARGET_ROOTFS_EXT2=y
BR2_TARGET_ROOTFS_EXT2_4=y
BR2_TARGET_ROOTFS_EXT2_SIZE="256M"
# BR2_TARGET_ROOTFS_TAR is not set
BR2_TARGET_OPENSBI=y
BR2_TARGET_OPENSBI_CUSTOM_VERSION=y
BR2_TARGET_OPENSBI_CUSTOM_VERSION_VALUE="1.4"
BR2_TARGET_OPENSBI_PLAT="generic"
BR2_TARGET_OPENSBI_LINUX_PAYLOAD=y
BR2_TARGET_OPENSBI_ADDITIONAL_VARIABLES="FW_TEXT_START=0"
BR2_TARGET_UBOOT=y
BR2_TARGET_UBOOT_BOARDNAME="k230d_canmv"
BR2_TARGET_UBOOT_CUSTOM_VERSION=y
BR2_TARGET_UBOOT_CUSTOM_VERSION_VALUE="2022.10"
BR2_PACKAGE_HOST_GENIMAGE=y
```

## buildroot-overlay/package/ai_demo/Config.in
```kconfig
config BR2_PACKAGE_AI_DEMO_ALL
    bool "all ai demo"
    select BR2_PACKAGE_DISPLAY
    select BR2_PACKAGE_GSL_LITE
    select BR2_PACKAGE_COMMON
    select BR2_PACKAGE_LLAMAC
    select BR2_PACKAGE_FACE_DETECTION
    select BR2_PACKAGE_DEMO_MIX
    select BR2_PACKAGE_BYTETRACK
    select BR2_PACKAGE_CROSSWALK_DETECT
    select BR2_PACKAGE_DYNAMIC_GESTURE
    select BR2_PACKAGE_EYE_GAZE
    select BR2_PACKAGE_FACE_ALIGNMENT
    select BR2_PACKAGE_FACE_EMOTION
    select BR2_PACKAGE_FACE_GENDER
    select BR2_PACKAGE_FACE_GLASSES
    select BR2_PACKAGE_FACE_LANDMARK
    select BR2_PACKAGE_FACE_MASK
    select BR2_PACKAGE_FACE_MESH
    select BR2_PACKAGE_FACE_PARSE
    select BR2_PACKAGE_FACE_POSE
    select BR2_PACKAGE_FACE_VERIFICATION
    select BR2_PACKAGE_FALLDOWN_DETECT
    select BR2_PACKAGE_FINGER_GUESSING
    select BR2_PACKAGE_FITNESS
    select BR2_PACKAGE_HEAD_DETECTION
    select BR2_PACKAGE_HELMET_DETECT
    select BR2_PACKAGE_KWS
    select BR2_PACKAGE_LICENCE_DET
    select BR2_PACKAGE_LICENCE_DET_REC
    select BR2_PACKAGE_OBJECT_DETECT_YOLOV8N
    select BR2_PACKAGE_OCR
    select BR2_PACKAGE_PERSON_ATTR
    select BR2_PACKAGE_PERSON_DETECT
    select BR2_PACKAGE_PERSON_DISTANCE
    select BR2_PACKAGE_POSE_DETECT
    select BR2_PACKAGE_PPHUMANSEG
    select BR2_PACKAGE_PUZZLE_GAME
    select BR2_PACKAGE_SEGMENT_YOLOV8N
    select BR2_PACKAGE_SMOKE_DETECT
    select BR2_PACKAGE_SPACE_RESIZE
    select BR2_PACKAGE_SQ_HAND_DET
    select BR2_PACKAGE_SQ_HANDKP_CLASS
    select BR2_PACKAGE_SQ_HANDKP_DET
    select BR2_PACKAGE_SQ_HANDKP_FLOWER
    select BR2_PACKAGE_SQ_HANDKP_OCR
    select BR2_PACKAGE_SQ_HANDRECO
    select BR2_PACKAGE_TRAFFIC_LIGHT_DETECT
    select BR2_PACKAGE_TTS_ZH
    select BR2_PACKAGE_VEHICLE_ATTR
    select BR2_PACKAGE_VIRTUAL_KEYBOARD
    select BR2_PACKAGE_YOLOP_LANE_SEG
    select BR2_PACKAGE_ANOMALY_DET
    help
        all ai demo

source "package/ai_demo/anomaly_det/Config.in"
source "package/ai_demo/common/Config.in"
source "package/ai_demo/face_detection/Config.in"
source "package/ai_demo/demo_mix/Config.in"
source "package/ai_demo/bytetrack/Config.in"
source "package/ai_demo/crosswalk_detect/Config.in"
source "package/ai_demo/dynamic_gesture/Config.in"
source "package/ai_demo/eye_gaze/Config.in"
source "package/ai_demo/face_alignment/Config.in"
source "package/ai_demo/face_emotion/Config.in"
source "package/ai_demo/face_gender/Config.in"
source "package/ai_demo/face_glasses/Config.in"
source "package/ai_demo/face_landmark/Config.in"
source "package/ai_demo/face_mask/Config.in"
source "package/ai_demo/face_mesh/Config.in"
source "package/ai_demo/face_parse/Config.in"
source "package/ai_demo/face_pose/Config.in"
source "package/ai_demo/face_verification/Config.in"
source "package/ai_demo/falldown_detect/Config.in"
source "package/ai_demo/finger_guessing/Config.in"
source "package/ai_demo/fitness/Config.in"
source "package/ai_demo/head_detection/Config.in"
source "package/ai_demo/helmet_detect/Config.in"
source "package/ai_demo/kws/Config.in"
source "package/ai_demo/licence_det/Config.in"
source "package/ai_demo/licence_det_rec/Config.in"
source "package/ai_demo/llamac/Config.in"
source "package/ai_demo/object_detect_yolov8n/Config.in"
source "package/ai_demo/ocr/Config.in"
source "package/ai_demo/person_attr/Config.in"
source "package/ai_demo/person_detect/Config.in"
source "package/ai_demo/person_distance/Config.in"
source "package/ai_demo/pose_detect/Config.in"
source "package/ai_demo/pphumanseg/Config.in"
source "package/ai_demo/puzzle_game/Config.in"
source "package/ai_demo/segment_yolov8n/Config.in"
source "package/ai_demo/smoke_detect/Config.in"
source "package/ai_demo/space_resize/Config.in"
source "package/ai_demo/sq_hand_det/Config.in"
source "package/ai_demo/sq_handkp_class/Config.in"
source "package/ai_demo/sq_handkp_det/Config.in"
source "package/ai_demo/sq_handkp_flower/Config.in"
source "package/ai_demo/sq_handkp_ocr/Config.in"
source "package/ai_demo/sq_handreco/Config.in"
source "package/ai_demo/traffic_light_detect/Config.in"
source "package/ai_demo/tts_zh/Config.in"
source "package/ai_demo/vehicle_attr/Config.in"
source "package/ai_demo/virtual_keyboard/Config.in"
source "package/ai_demo/yolop_lane_seg/Config.in"
```

## buildroot-overlay/package/ai_demo/anomaly_det/Config.in
```kconfig
config BR2_PACKAGE_ANOMALY_DET
    bool "anomaly detect"
    select BR2_PACKAGE_DISPLAY
    select BR2_PACKAGE_GSL_LITE
    select BR2_PACKAGE_COMMON
    help
        ai demo anomaly detect
```

## buildroot-overlay/package/ai_demo/bytetrack/Config.in
```kconfig
config BR2_PACKAGE_BYTETRACK
    bool "bytetrack"
    select BR2_PACKAGE_DISPLAY
    select BR2_PACKAGE_GSL_LITE
    select BR2_PACKAGE_COMMON
    help
        ai demo bytetrack
```

## buildroot-overlay/package/ai_demo/common/Config.in
```kconfig
config BR2_PACKAGE_COMMON
    bool "ai demo common"
    select BR2_PACKAGE_DISPLAY
    select BR2_PACKAGE_GSL_LITE
    help
        ai demo common code
```

## buildroot-overlay/package/ai_demo/crosswalk_detect/Config.in
```kconfig
config BR2_PACKAGE_CROSSWALK_DETECT
    bool "crosswalk detect"
    select BR2_PACKAGE_DISPLAY
    select BR2_PACKAGE_GSL_LITE
    select BR2_PACKAGE_COMMON
    help
        ai demo crosswalk detect
```

## buildroot-overlay/package/ai_demo/demo_mix/Config.in
```kconfig
config BR2_PACKAGE_DEMO_MIX
    bool "demo mix"
    select BR2_PACKAGE_DISPLAY
    select BR2_PACKAGE_GSL_LITE
    select BR2_PACKAGE_COMMON
    help
        demo mix
```

## buildroot-overlay/package/ai_demo/dynamic_gesture/Config.in
```kconfig
config BR2_PACKAGE_DYNAMIC_GESTURE
    bool "dynamic_gesture"
    select BR2_PACKAGE_DISPLAY
    select BR2_PACKAGE_GSL_LITE
    select BR2_PACKAGE_COMMON
    help
        ai demo dynamic_gesture
```

## buildroot-overlay/package/ai_demo/eye_gaze/Config.in
```kconfig
config BR2_PACKAGE_EYE_GAZE
    bool "eye_gaze"
    select BR2_PACKAGE_DISPLAY
    select BR2_PACKAGE_GSL_LITE
    select BR2_PACKAGE_COMMON
    help
        ai demo eye_gaze
```

## buildroot-overlay/package/ai_demo/face_detection/Config.in
```kconfig
config BR2_PACKAGE_FACE_DETECTION
    bool "face detection"
    default y
    select BR2_PACKAGE_DISPLAY
    select BR2_PACKAGE_GSL_LITE
    select BR2_PACKAGE_COMMON
    help
        ai demo face detection
```

## buildroot-overlay/package/ai_demo/face_emotion/Config.in
```kconfig
config BR2_PACKAGE_FACE_EMOTION
    bool "face_emotion"
    select BR2_PACKAGE_DISPLAY
    select BR2_PACKAGE_GSL_LITE
    select BR2_PACKAGE_COMMON
    help
        ai demo face_emotion
```

## buildroot-overlay/package/ai_demo/face_gender/Config.in
```kconfig
config BR2_PACKAGE_FACE_GENDER
    bool "face_gender"
    select BR2_PACKAGE_DISPLAY
    select BR2_PACKAGE_GSL_LITE
    select BR2_PACKAGE_COMMON
    help
        ai demo face_gender
```

## buildroot-overlay/package/ai_demo/face_glasses/Config.in
```kconfig
config BR2_PACKAGE_FACE_GLASSES
    bool "face_glasses"
    select BR2_PACKAGE_DISPLAY
    select BR2_PACKAGE_GSL_LITE
    select BR2_PACKAGE_COMMON
    help
        ai demo face_glasses
```

## buildroot-overlay/package/ai_demo/face_landmark/Config.in
```kconfig
config BR2_PACKAGE_FACE_LANDMARK
    bool "face_landmark"
    select BR2_PACKAGE_DISPLAY
    select BR2_PACKAGE_GSL_LITE
    select BR2_PACKAGE_COMMON
    help
        ai demo face_landmark
```

## buildroot-overlay/package/ai_demo/face_mask/Config.in
```kconfig
config BR2_PACKAGE_FACE_MASK
    bool "face_mask"
    select BR2_PACKAGE_DISPLAY
    select BR2_PACKAGE_GSL_LITE
    select BR2_PACKAGE_COMMON
    help
        ai demo face_mask
```

## buildroot-overlay/package/ai_demo/face_mesh/Config.in
```kconfig
config BR2_PACKAGE_FACE_MESH
    bool "face_mesh"
    select BR2_PACKAGE_DISPLAY
    select BR2_PACKAGE_GSL_LITE
    select BR2_PACKAGE_COMMON
    help
        ai demo face_mesh
```

## buildroot-overlay/package/ai_demo/face_parse/Config.in
```kconfig
config BR2_PACKAGE_FACE_PARSE
    bool "face_parse"
    select BR2_PACKAGE_DISPLAY
    select BR2_PACKAGE_GSL_LITE
    select BR2_PACKAGE_COMMON
    help
        ai demo face_parse
```

## buildroot-overlay/package/ai_demo/face_pose/Config.in
```kconfig
config BR2_PACKAGE_FACE_POSE
    bool "face_pose"
    select BR2_PACKAGE_DISPLAY
    select BR2_PACKAGE_GSL_LITE
    select BR2_PACKAGE_COMMON
    help
        ai demo face_pose
```

## buildroot-overlay/package/ai_demo/face_verification/Config.in
```kconfig
config BR2_PACKAGE_FACE_VERIFICATION
    bool "face_verification"
    select BR2_PACKAGE_GSL_LITE
    select BR2_PACKAGE_COMMON
    select BR2_PACKAGE_DISPLAY
    help
        ai demo face_verification
```

## buildroot-overlay/package/ai_demo/falldown_detect/Config.in
```kconfig
config BR2_PACKAGE_FALLDOWN_DETECT
    bool "falldown_detect"
    select BR2_PACKAGE_GSL_LITE
    select BR2_PACKAGE_COMMON
    select BR2_PACKAGE_DISPLAY
    help
        ai demo falldown_detect
```

## buildroot-overlay/package/ai_demo/finger_guessing/Config.in
```kconfig
config BR2_PACKAGE_FINGER_GUESSING
    bool "finger_guessing"
    select BR2_PACKAGE_GSL_LITE
    select BR2_PACKAGE_COMMON
    select BR2_PACKAGE_DISPLAY
    help
        ai demo finger_guessing
```

## buildroot-overlay/package/ai_demo/fitness/Config.in
```kconfig
config BR2_PACKAGE_FITNESS
    bool "fitness"
    select BR2_PACKAGE_GSL_LITE
    select BR2_PACKAGE_COMMON
    select BR2_PACKAGE_DISPLAY
    help
        ai demo fitness
```

## buildroot-overlay/package/ai_demo/head_detection/Config.in
```kconfig
config BR2_PACKAGE_HEAD_DETECTION
    bool "head_detection"
    select BR2_PACKAGE_GSL_LITE
    select BR2_PACKAGE_COMMON
    select BR2_PACKAGE_DISPLAY
    help
        ai demo head_detection
```
