## buildroot-overlay/package/ai2d_kpu/Config.in
```kconfig
config BR2_PACKAGE_AI2D_KPU
    bool "ai2d kpu test case"
    help
        ai2d and kpu test case
```

## buildroot-overlay/package/audio_demo/Config.in
```kconfig
config BR2_PACKAGE_AUDIO_DEMO
    bool "audio demo"
    select BR2_PACKAGE_ALSA_UTILS
    select BR2_PACKAGE_ALURE
    select BR2_PACKAGE_ALURE_MINIMP3_DECODER
    help
        Audio demo for recording, playing, encoding, decoding, and audio3a.
```

## buildroot-overlay/package/audio_rec_play/Config.in
```kconfig
config BR2_PACKAGE_AUDIO_REC_PLAY
    bool "audio_rec_play"
    select BR2_PACKAGE_ALSA_UTILS
    select BR2_PACKAGE_SPEEXDSP
    help
      This is a package for audio recording and playback and enables audio quality enhancement features.
```

## buildroot-overlay/package/camera_rtsp_demo/Config.in
```kconfig
config BR2_PACKAGE_CAMERA_RTSP_DEMO
    bool "Enable Camera RTSP Demo"
    depends on BR2_PACKAGE_LIVE555
    depends on BR2_PACKAGE_LIB_RTSPSERVER
    help
      This option enables the Camera RTSP Demo package, which provides
      a demonstration of streaming video from a camera using the RTSP protocol.
```

## buildroot-overlay/package/display/Config.in
```kconfig
config BR2_PACKAGE_DISPLAY
    bool "libdrm abstruct library for display"
    select BR2_PACKAGE_LIBDRM
```

## buildroot-overlay/package/gsl-lite/Config.in
```kconfig
config BR2_PACKAGE_GSL_LITE
    bool "gsl-lite is an implementation of the C++ Core Guidelines Support Library originally based on Microsoft GSL."
```
