## buildroot-overlay/boot/uboot/u-boot-2022.10-overlay/arch/riscv/cpu/k230/Kconfig
```kconfig
#
# Copyright (C) 2017-2020 Alibaba Group Holding Limited
#
# SPDX-License-Identifier: GPL-2.0+
#

config RISCV_THEAD
	bool
	select ARCH_EARLY_INIT_R
	select SUPPORT_SPL
	imply CPU
	imply CPU_RISCV
	imply RISCV_TIMER
	imply RISCV_RDTIME
	imply CMD_CPU
	imply SPL_CPU
	imply SPL_OPENSBI
	imply SPL_LOAD_FIT


if RISCV_THEAD
config DDR_SIZE
	hex "DDR  Size"
	default 0x80000000 if LPDDR4_2667
	default 0x08000000 if SIPLP4_3200_WODT
	default 0x08000000 if SIPLP4_3200_WALLODT
	default 0x08000000 if SIPLP4_2667
	default 0x08000000 if SIPLP4_1600
	default 0x40000000 if CANMV_01STUDIO_LPDDR4_2667
	default 0x40000000 if CANMV_01STUDIO_LPDDR4_3200
	default 0x20000000
	help
	  Size of the DDR

config K230_BARE_DISP_LOGO
	bool "display k230 bare logo"
	select LAST_STAGE_INIT
	help
	  display k230 bare logo,bare-metal program

config K230_BARE_DISP_LOGO_PATH
	string "logo yuv nv12 pic path"
	default "board/canaan/k230-soc/logo/logo.yuv"
	depends on K230_BARE_DISP_LOGO
	help
	  logo pic,df sceen is 480*640,need yuv_nv12_640*480 pic;

config K230_BARE_DISP_LOGO_DF
	bool "df screen"
	depends on K230_BARE_DISP_LOGO
	help
	  df screen


endif
```

## buildroot-overlay/boot/uboot/u-boot-2022.10-overlay/board/canaan/k230_canmv_gt6700/Kconfig
```kconfig
if TARGET_K230_CANMV_GT6700

config SYS_CPU
	default "k230"

config SYS_VENDOR
    default "canaan"

config SYS_BOARD
    default "k230_canmv_gt6700"

config SYS_CONFIG_NAME
    default "k230_evb"


config BOARD_SPECIFIC_OPTIONS # dummy
	def_bool y
	select RISCV_THEAD

choice
	prompt "ddr typy freq"
    default CANMV_GT6700_LPDDR4_2667

    config CANMV_GT6700_LPDDR4_2667
	    bool "canmv gt6700 LP4_2667"
        help
            "CANMV GT6700,lushanpai,01studio"

    config CANMV_GT6700_LPDDR4_3200
	    bool "canmv gt6700 LP4_3200"
        help
            "CANMV GT6700,lushanpai,01studio"

    config CANMV_GT6700_LPDDR4_1600_WITHOUT_ODT
	    bool "canmv gt6700 LP4_1600 WITHOUT ODT"
        help
            "CANMV GT6700,lushanpai,01studio"
endchoice

endif
```

## buildroot-overlay/configs/BPI-CanMV-K230D-Zero_ilp32_defconfig
```kconfig
BR2_riscv=y
BR2_RISCV_ISA_RVC=y
BR2_RISCV_32=y
BR2_TOOLCHAIN_EXTERNAL=y
BR2_TOOLCHAIN_EXTERNAL_CUSTOM=y
BR2_TOOLCHAIN_EXTERNAL_PATH="/opt/toolchain/Xuantie-900-gcc-linux-6.6.0-glibc-x86_64-V2.10.1"
BR2_TOOLCHAIN_EXTERNAL_CUSTOM_PREFIX="riscv64-unknown-linux-gnu"
BR2_TOOLCHAIN_EXTERNAL_GCC_10=y
BR2_TOOLCHAIN_EXTERNAL_HEADERS_6_6=y
BR2_TOOLCHAIN_EXTERNAL_CUSTOM_GLIBC=y
# BR2_TOOLCHAIN_EXTERNAL_INET_RPC is not set
BR2_TOOLCHAIN_EXTERNAL_CXX=y
BR2_TOOLCHAIN_EXTERNAL_FORTRAN=y
BR2_TOOLCHAIN_EXTERNAL_OPENMP=y
BR2_DL_DIR="$(TOPDIR)/../../dl"
BR2_SSP_REGULAR=y
BR2_FORTIFY_SOURCE_NONE=y
BR2_SYSTEM_DHCP="eth0"
BR2_ROOTFS_OVERLAY="board/canaan/k230-soc/rootfs_overlay"
BR2_ROOTFS_POST_BUILD_SCRIPT="board/canaan/k230-soc/post-build.sh"
BR2_ROOTFS_POST_IMAGE_SCRIPT="board/canaan/k230-soc/post-image.sh"
BR2_ROOTFS_POST_SCRIPT_ARGS="k230d-canmv $(LINUX_DIR)"
BR2_LINUX_KERNEL=y
BR2_LINUX_KERNEL_CUSTOM_GIT=y
BR2_LINUX_KERNEL_CUSTOM_REPO_URL="https://github.com/ruyisdk/linux-xuantie-kernel.git"
BR2_LINUX_KERNEL_CUSTOM_REPO_VERSION="cb33eeb4c893187316a787414409a30605c529b0"
BR2_LINUX_KERNEL_DEFCONFIG="k230"
BR2_LINUX_KERNEL_DTS_SUPPORT=y
BR2_LINUX_KERNEL_INTREE_DTS_NAME="canaan/bananapi-canmv-k230d-zero.dts"
BR2_LINUX_KERNEL_INSTALL_TARGET=y
BR2_PACKAGE_LINUX_ILP32=y
BR2_PACKAGE_AUDIO_DEMO=y
BR2_PACKAGE_FIO=y
BR2_PACKAGE_E2FSPROGS=y
BR2_PACKAGE_E2FSPROGS_RESIZE2FS=y
BR2_PACKAGE_VG_LITE_DEMOS=y
BR2_PACKAGE_PARTED=y
BR2_PACKAGE_FREETYPE=y
BR2_PACKAGE_LIBDRM_INSTALL_TESTS=y
BR2_PACKAGE_LIBGPIOD=y
BR2_PACKAGE_LIBGPIOD_TOOLS=y
BR2_PACKAGE_IPERF3=y
BR2_TARGET_ROOTFS_EXT2=y
BR2_TARGET_ROOTFS_EXT2_4=y
BR2_TARGET_ROOTFS_EXT2_SIZE="128M"
# BR2_TARGET_ROOTFS_TAR is not set
BR2_TARGET_OPENSBI=y
BR2_TARGET_OPENSBI_CUSTOM_VERSION=y
BR2_TARGET_OPENSBI_CUSTOM_VERSION_VALUE="1.4"
BR2_TARGET_OPENSBI_PLAT="generic"
BR2_TARGET_OPENSBI_LINUX_PAYLOAD=y
BR2_TARGET_OPENSBI_ADDITIONAL_VARIABLES="FW_TEXT_START=0"
BR2_TARGET_UBOOT=y
BR2_TARGET_UBOOT_BOARDNAME="k230d_canmv_bp"
BR2_TARGET_UBOOT_CUSTOM_VERSION=y
BR2_TARGET_UBOOT_CUSTOM_VERSION_VALUE="2022.10"
BR2_PACKAGE_HOST_GENIMAGE=y
```

## buildroot-overlay/configs/k230_canmv_01studio_defconfig
```kconfig
BR2_riscv=y
BR2_RISCV_ISA_RVC=y
BR2_TOOLCHAIN_EXTERNAL=y
BR2_TOOLCHAIN_EXTERNAL_CUSTOM=y
BR2_TOOLCHAIN_EXTERNAL_PATH="/opt/toolchain/Xuantie-900-gcc-linux-6.6.0-glibc-x86_64-V2.10.1"
BR2_TOOLCHAIN_EXTERNAL_CUSTOM_PREFIX="riscv64-unknown-linux-gnu"
BR2_TOOLCHAIN_EXTERNAL_GCC_10=y
BR2_TOOLCHAIN_EXTERNAL_HEADERS_6_6=y
BR2_TOOLCHAIN_EXTERNAL_CUSTOM_GLIBC=y
# BR2_TOOLCHAIN_EXTERNAL_INET_RPC is not set
BR2_TOOLCHAIN_EXTERNAL_CXX=y
BR2_TOOLCHAIN_EXTERNAL_FORTRAN=y
BR2_TOOLCHAIN_EXTERNAL_OPENMP=y
BR2_DL_DIR="$(TOPDIR)/../../dl"
BR2_SYSTEM_DHCP="eth0"
BR2_ROOTFS_OVERLAY="board/canaan/k230-soc/rootfs_overlay"
BR2_ROOTFS_POST_BUILD_SCRIPT="board/canaan/k230-soc/post-build.sh"
BR2_ROOTFS_POST_IMAGE_SCRIPT="board/canaan/k230-soc/post-image.sh"
BR2_ROOTFS_POST_SCRIPT_ARGS="k230-canmv-01studio $(LINUX_DIR)"
BR2_LINUX_KERNEL=y
BR2_LINUX_KERNEL_CUSTOM_GIT=y
BR2_LINUX_KERNEL_CUSTOM_REPO_URL="https://github.com/ruyisdk/linux-xuantie-kernel.git"
BR2_LINUX_KERNEL_CUSTOM_REPO_VERSION="f83d0bb671ec62f0eb43c0434b081735e1e1c4f9"
BR2_LINUX_KERNEL_DEFCONFIG="k230"
BR2_LINUX_KERNEL_DTS_SUPPORT=y
BR2_LINUX_KERNEL_INTREE_DTS_NAME="canaan/k230-canmv-01studio"
BR2_LINUX_KERNEL_INSTALL_TARGET=y
BR2_PACKAGE_LINUX_TOOLS_GPIO=y
BR2_PACKAGE_ALSA_UTILS=y
BR2_PACKAGE_FFMPEG=y
BR2_PACKAGE_VVCAM=y
BR2_PACKAGE_COREMARK=y
BR2_PACKAGE_COREMARK_PRO=y
BR2_PACKAGE_VG_LITE_DEMOS=y
BR2_PACKAGE_LIBGPIOD=y
BR2_PACKAGE_LIBGPIOD_TOOLS=y
BR2_PACKAGE_LRZSZ=y
BR2_TARGET_ROOTFS_EXT2=y
BR2_TARGET_ROOTFS_EXT2_4=y
BR2_TARGET_ROOTFS_EXT2_SIZE="128M"
BR2_TARGET_OPENSBI=y
BR2_TARGET_OPENSBI_CUSTOM_VERSION=y
BR2_TARGET_OPENSBI_CUSTOM_VERSION_VALUE="1.4"
BR2_TARGET_OPENSBI_PLAT="generic"
# BR2_TARGET_OPENSBI_INSTALL_DYNAMIC_IMG is not set
BR2_TARGET_OPENSBI_LINUX_PAYLOAD=y
BR2_TARGET_OPENSBI_ADDITIONAL_VARIABLES="FW_TEXT_START=0"
BR2_TARGET_UBOOT=y
BR2_TARGET_UBOOT_BOARDNAME="k230_canmv_01studio"
BR2_TARGET_UBOOT_CUSTOM_VERSION=y
BR2_TARGET_UBOOT_CUSTOM_VERSION_VALUE="2022.10"
BR2_PACKAGE_HOST_GENIMAGE=y
```

## buildroot-overlay/configs/k230_canmv_defconfig
```kconfig
BR2_riscv=y
BR2_RISCV_ISA_RVC=y
BR2_RISCV_ISA_RVV=y
BR2_GCC_VERSION_14_X=y
BR2_TOOLCHAIN_BUILDROOT_CXX=y
BR2_DL_DIR="$(TOPDIR)/../../dl"
BR2_SYSTEM_DHCP="eth0"
BR2_ROOTFS_OVERLAY="board/canaan/k230-soc/rootfs_overlay"
BR2_ROOTFS_POST_BUILD_SCRIPT="board/canaan/k230-soc/post-build.sh"
BR2_ROOTFS_POST_IMAGE_SCRIPT="board/canaan/k230-soc/post-image.sh"
BR2_ROOTFS_POST_SCRIPT_ARGS="k230-canmv $(LINUX_DIR)"
BR2_LINUX_KERNEL=y
BR2_LINUX_KERNEL_CUSTOM_GIT=y
BR2_LINUX_KERNEL_CUSTOM_REPO_URL="https://github.com/ruyisdk/linux-xuantie-kernel.git"
BR2_LINUX_KERNEL_CUSTOM_REPO_VERSION="011eb4c8178644b373fe50a7b583942a036a3429"
BR2_LINUX_KERNEL_DEFCONFIG="k230"
BR2_LINUX_KERNEL_DTS_SUPPORT=y
BR2_LINUX_KERNEL_INTREE_DTS_NAME="canaan/k230d-canmv"
BR2_LINUX_KERNEL_INSTALL_TARGET=y
BR2_PACKAGE_LINUX_TOOLS_GPIO=y
BR2_PACKAGE_ALSA_UTILS=y
BR2_PACKAGE_FFMPEG=y
BR2_PACKAGE_VVCAM=y
BR2_PACKAGE_COREMARK=y
BR2_PACKAGE_COREMARK_PRO=y
BR2_PACKAGE_VG_LITE_DEMOS=y
BR2_PACKAGE_LIBGPIOD=y
BR2_PACKAGE_LIBGPIOD_TOOLS=y
BR2_TARGET_ROOTFS_EXT2=y
BR2_TARGET_ROOTFS_EXT2_4=y
BR2_TARGET_ROOTFS_EXT2_SIZE="128M"
BR2_TARGET_OPENSBI=y
BR2_TARGET_OPENSBI_CUSTOM_VERSION=y
BR2_TARGET_OPENSBI_CUSTOM_VERSION_VALUE="1.4"
BR2_TARGET_OPENSBI_PLAT="generic"
# BR2_TARGET_OPENSBI_INSTALL_DYNAMIC_IMG is not set
BR2_TARGET_OPENSBI_LINUX_PAYLOAD=y
BR2_TARGET_OPENSBI_ADDITIONAL_VARIABLES="FW_TEXT_START=0"
BR2_TARGET_UBOOT=y
BR2_TARGET_UBOOT_BOARDNAME="k230_canmv"
BR2_TARGET_UBOOT_CUSTOM_VERSION=y
BR2_TARGET_UBOOT_CUSTOM_VERSION_VALUE="2022.10"
BR2_PACKAGE_HOST_GENIMAGE=y
```

## buildroot-overlay/configs/k230d_canmv_32bit_defconfig
```kconfig
BR2_riscv=y
BR2_RISCV_32=y
BR2_DL_DIR="$(TOPDIR)/../../dl"
BR2_SYSTEM_DHCP="eth0"
BR2_ROOTFS_OVERLAY="board/canaan/k230-soc/rootfs_overlay"
BR2_ROOTFS_POST_BUILD_SCRIPT="board/canaan/k230-soc/post-build.sh"
BR2_ROOTFS_POST_IMAGE_SCRIPT="board/canaan/k230-soc/post-image.sh"
BR2_ROOTFS_POST_SCRIPT_ARGS="k230d-canmv $(LINUX_DIR)"
BR2_TARGET_ROOTFS_EXT2=y
```

## buildroot-overlay/configs/k230d_canmv_32bit_rootfs_defconfig
```kconfig
BR2_riscv=y
BR2_RISCV_ISA_RVC=y
BR2_RISCV_32=y
BR2_TOOLCHAIN_EXTERNAL=y
BR2_TOOLCHAIN_EXTERNAL_CUSTOM=y
BR2_TOOLCHAIN_EXTERNAL_PATH="/opt/toolchain/Xuantie-900-gcc-linux-6.6.0-glibc-x86_64-V2.10.1"
BR2_TOOLCHAIN_EXTERNAL_CUSTOM_PREFIX="riscv64-unknown-linux-gnu"
BR2_TOOLCHAIN_EXTERNAL_GCC_10=y
BR2_TOOLCHAIN_EXTERNAL_HEADERS_6_6=y
BR2_TOOLCHAIN_EXTERNAL_CUSTOM_GLIBC=y
# BR2_TOOLCHAIN_EXTERNAL_INET_RPC is not set
BR2_TOOLCHAIN_EXTERNAL_CXX=y
BR2_TOOLCHAIN_EXTERNAL_FORTRAN=y
BR2_TOOLCHAIN_EXTERNAL_OPENMP=y
BR2_DL_DIR="$(TOPDIR)/../../dl"
BR2_SSP_REGULAR=y
BR2_FORTIFY_SOURCE_NONE=y
BR2_SYSTEM_DHCP="eth0"
BR2_ROOTFS_OVERLAY="board/canaan/k230-soc/rootfs_overlay"
BR2_ROOTFS_POST_BUILD_SCRIPT="board/canaan/k230-soc/post-build.sh"
BR2_PACKAGE_FIO=y
BR2_PACKAGE_E2FSPROGS=y
BR2_PACKAGE_LIBDRM=y
BR2_PACKAGE_LIBGPIOD=y
BR2_PACKAGE_LIBGPIOD_TOOLS=y
BR2_PACKAGE_IPERF3=y
BR2_TARGET_ROOTFS_EXT2=y
BR2_TARGET_ROOTFS_EXT2_4=y
BR2_TARGET_ROOTFS_EXT2_SIZE="128M"
# BR2_TARGET_ROOTFS_TAR is not set
BR2_PACKAGE_HOST_GENIMAGE=y
```

## buildroot-overlay/configs/k230d_canmv_64bit_k_u_o_defconfig
```kconfig
BR2_riscv=y
BR2_RISCV_ISA_RVC=y
BR2_RISCV_ISA_RVV=y
BR2_TOOLCHAIN_BUILDROOT_CXX=y
BR2_DL_DIR="$(TOPDIR)/../../dl"
BR2_INIT_NONE=y
# BR2_TARGET_ENABLE_ROOT_LOGIN is not set
BR2_LINUX_KERNEL=y
BR2_LINUX_KERNEL_CUSTOM_GIT=y
BR2_LINUX_KERNEL_CUSTOM_REPO_URL="https://github.com/ruyisdk/linux-xuantie-kernel.git"
BR2_LINUX_KERNEL_CUSTOM_REPO_VERSION="ed355eaf610e081ebb1175b80d9e2a0280484c74"
BR2_LINUX_KERNEL_USE_ARCH_DEFAULT_CONFIG=y
# BR2_PACKAGE_BUSYBOX is not set
# BR2_TARGET_ROOTFS_TAR is not set
BR2_TARGET_OPENSBI=y
BR2_TARGET_OPENSBI_CUSTOM_VERSION=y
BR2_TARGET_OPENSBI_CUSTOM_VERSION_VALUE="1.4"
BR2_TARGET_OPENSBI_PLAT="generic"
# BR2_TARGET_OPENSBI_INSTALL_DYNAMIC_IMG is not set
# BR2_TARGET_OPENSBI_INSTALL_JUMP_IMG is not set
BR2_TARGET_OPENSBI_LINUX_PAYLOAD=y
BR2_TARGET_OPENSBI_ADDITIONAL_VARIABLES="FW_TEXT_START=0"
BR2_TARGET_UBOOT=y
BR2_TARGET_UBOOT_BOARDNAME="k230d_canmv"
BR2_TARGET_UBOOT_CUSTOM_VERSION=y
BR2_TARGET_UBOOT_CUSTOM_VERSION_VALUE="2022.10"
```

## buildroot-overlay/configs/k230d_canmv_64kernel_32rootfs_defconfig
```kconfig
BR2_riscv=y
BR2_RISCV_ISA_RVC=y
BR2_RISCV_ISA_RVV=y
BR2_TOOLCHAIN_BUILDROOT_CXX=y
BR2_DL_DIR="$(TOPDIR)/../../dl"
BR2_INIT_NONE=y
# BR2_TARGET_ENABLE_ROOT_LOGIN is not set
BR2_ROOTFS_POST_IMAGE_SCRIPT="board/canaan/k230-soc/post-image.sh"
BR2_ROOTFS_POST_SCRIPT_ARGS="k230d-canmv $(LINUX_DIR) $(TOPDIR)/../k230d_canmv_32bit_rootfs_defconfig/images/rootfs.ext4"
BR2_LINUX_KERNEL=y
BR2_LINUX_KERNEL_CUSTOM_GIT=y
BR2_LINUX_KERNEL_CUSTOM_REPO_URL="https://github.com/ruyisdk/linux-xuantie-kernel.git"
BR2_LINUX_KERNEL_CUSTOM_REPO_VERSION="b6516a27c813582a837d73330f939beba3e019c7"
BR2_LINUX_KERNEL_DEFCONFIG="k230"
# BR2_PACKAGE_BUSYBOX is not set
# BR2_TARGET_ROOTFS_TAR is not set
BR2_TARGET_OPENSBI=y
BR2_TARGET_OPENSBI_CUSTOM_VERSION=y
BR2_TARGET_OPENSBI_CUSTOM_VERSION_VALUE="1.4"
BR2_TARGET_OPENSBI_PLAT="generic"
# BR2_TARGET_OPENSBI_INSTALL_DYNAMIC_IMG is not set
# BR2_TARGET_OPENSBI_INSTALL_JUMP_IMG is not set
BR2_TARGET_OPENSBI_LINUX_PAYLOAD=y
BR2_TARGET_OPENSBI_ADDITIONAL_VARIABLES="FW_TEXT_START=0"
BR2_TARGET_UBOOT=y
BR2_TARGET_UBOOT_BOARDNAME="k230d_canmv"
BR2_TARGET_UBOOT_CUSTOM_VERSION=y
BR2_TARGET_UBOOT_CUSTOM_VERSION_VALUE="2022.10"
BR2_PACKAGE_HOST_GENIMAGE=y
```

## buildroot-overlay/linux/linux-6.6.22-overlay/drivers/canaan-hardlock/Kconfig
```kconfig
menu "canaan-hardlock"


config CANAAN_HARDLOCK
	bool "canaan hardlock driver"

endmenu
```

## buildroot-overlay/linux/linux-6.6.22-overlay/drivers/gpu/drm/canaan/Kconfig
```kconfig
# SPDX-License-Identifier: GPL-2.0-only
config DRM_CANAAN
    bool "DRM Support for Canaan K230 Display Controller"
    depends on OF
    depends on COMMON_CLK
    select DRM
    select DRM_KMS_HELPER
    select DRM_KMS_DMA_HELPER
    select DRM_GEM_DMA_HELPER
    select VIDEOMODE_HELPERS
    default ARCH_CANAAN
    help
        Choose this option to enable DRM on Canaan K230 chipset

if DRM_CANAAN

config DRM_CANAAN_DSI
	bool "Canaan K230 MIPI-DSI Controller Support"
	select DRM_MIPI_DSI
        default DRM_CANAAN
	help
        Choose this option to enable Canaan K230 MIPI-DSI Controller

endif
```

## buildroot-overlay/linux/linux-6.6.22-overlay/drivers/media/platform/vvcam/Kconfig
```kconfig
config VVCAM
	tristate "Verisilicon ISP driver for K230"
	default n
	depends on VIDEO_DEV
	select VVCAM_VB
	select VVCAM_MIPI
	select VVCAM_ISP
	select VVCAM_ISP_SUBDEV
	select VVCAM_VIDEO

config VVCAM_VB
	tristate "Verisilicon ISP driver for K230 VB"
	depends on VVCAM

config VVCAM_MIPI
	tristate "Verisilicon ISP driver for K230 MIPI"
	depends on VVCAM
	
config VVCAM_ISP
	tristate "Verisilicon ISP driver for K230 ISP"
	depends on VVCAM

config VVCAM_ISP_SUBDEV
	tristate "Verisilicon ISP driver for K230 ISP Subdev"
	depends on VVCAM
	select V4L2_FWNODE

config VVCAM_VIDEO
	tristate "Verisilicon ISP driver for K230 Video"
	depends on VVCAM
	select VIDEOBUF2_DMA_CONTIG
```

## buildroot-overlay/linux/linux-6.6.22-overlay/drivers/misc/canaan/Kconfig
```kconfig
menu "Canaan k230 drivers"

source "drivers/misc/canaan/gnne/Kconfig"
source "drivers/misc/canaan/ai2d/Kconfig"

endmenu
```

## buildroot-overlay/linux/linux-6.6.22-overlay/drivers/misc/canaan/ai2d/Kconfig
```kconfig
    config K230_AI2D_DRIVER
        tristate "K230 AI2D test driver"
        default	m
        help
          Say Y for enabling the k230 AI2D test driver

          To compile this support as a module, choose M here:
          The module will be called allegro_encoder.
          If unsure, say N.
```

## buildroot-overlay/linux/linux-6.6.22-overlay/drivers/misc/canaan/gnne/Kconfig
```kconfig
    config K230_GNNE_DRIVER
        tristate "K230 GNNE test driver"
        default	m
        help
          Say Y for enabling the k230 gnne test driver

          To compile this support as a module, choose M here:
          The module will be called allegro_encoder.
          If unsure, say N.
```

## buildroot-overlay/linux/linux-6.6.22-overlay/drivers/soc/canaan/Kconfig
```kconfig
# SPDX-License-Identifier: GPL-2.0

config SOC_K210_SYSCTL
	bool "Canaan Kendryte K210 SoC system controller"
	depends on RISCV && SOC_CANAAN_K210 && OF
	depends on COMMON_CLK_K210
	default SOC_CANAAN_K210
	select PM
	select MFD_SYSCON
	help
	  Canaan Kendryte K210 SoC system controller driver.

config SOC_K230_PM_DOMAINS
	bool "Canaan Kendryte K230 power domains controller"
	depends on RISCV && OF && ARCH_CANAAN
	select PM_GENERIC_DOMAINS if PM
	select CANAAN_HARDLOCK
	default ARCH_CANAAN
	help
	  Canaan Kendryte K230 SoC power domains driver.
```

## buildroot-overlay/linux/linux_ilp32/Config.in
```kconfig
config BR2_PACKAGE_LINUX_ILP32
	bool "build RV64ILP32 64ilp32.config  Linux Kernel "
	default n
	help
	  Enable this option if you want to build a  RV64ILP32 64ilp32.config
	  Linux kernel for your embedded device

config BR2_TOOLCHAIN_EXTERNAL_RUYI_NEW32_RV64ILP32_BIN_PATH
	string "ruyi new 32 bit Toolchain relative binary path"
	default "/opt/toolchain/riscv64ilp32-elf-ubuntu-22.04-gcc-nightly-2024.06.25/riscv"
	depends on 	BR2_PACKAGE_LINUX_ILP32
	help
	  Path to where the binaries (e.g. the compiler) can be found,
	  relative to the downloaded toolchain root directory. The
	  default is "bin" and is correct for most toolchains.

config BR2_TOOLCHAIN_EXTERNAL_RUYI_NEW32_RV64ILP32_PREFIX
	string "Ruyi new 32 bit Toolchain prefix"
	default "riscv64-unknown-elf"
	depends on 	BR2_PACKAGE_LINUX_ILP32
	help
	  Component name prefix used by your external toolchain.
```
