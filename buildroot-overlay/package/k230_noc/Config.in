## buildroot-overlay/package/k230_noc/Config.in
```kconfig
config BR2_PACKAGE_K230_NOC
    bool "k230 noc "
    default n
    help
        k230 noc probe qos
```

## buildroot-overlay/package/libmmz/Config.in
```kconfig
config BR2_PACKAGE_LIBMMZ
    bool "libmmz"
    select BR2_PACKAGE_LIBUBOOTENV
    help
        mmz lib
```

## buildroot-overlay/package/lvgl/Config.in
```kconfig
config BR2_PACKAGE_LVGL
    bool "LVGL demo and library"
    select BR2_PACKAGE_LIBDRM
    help
        LVGL demo and library

config BR2_PACKAGE_LVGL_CUSTOM_VERSION
	string "lvgl version"
    default "97a99a8affe966617f048830a007bbf8bea63da6"
    depends on  BR2_PACKAGE_LVGL
	help
	  This option allows to use a specific official version from
	  lvgl, only surpport 8.3.7   59dc7e436ae97a25e32656739ea6a943f9f11b6a  97a99a8affe966617f048830a007bbf8bea63da6
```

## buildroot-overlay/package/nonai2d/Config.in
```kconfig
config BR2_PACKAGE_NONAI2D
    bool "nonai2d"
    default n
    help
        k230 nonai 2d driver
```

## buildroot-overlay/package/python-adafruit-blinka/Config.in
```kconfig
config BR2_PACKAGE_PYTHON_ADAFRUIT_BLINKA
	bool "python-adafruit-blinka"
	select BR2_PACKAGE_PYTHON3
	select BR2_PACKAGE_PYTHON_ADAFRUIT_PLATFORMDETECT
	select BR2_PACKAGE_PYTHON_ADAFRUIT_PUREIO
	select BR2_PACKAGE_PYTHON_SERIAL

	help
	  Adafruit Blinka provides CircuitPython APIs for non-CircuitPython
	  single-board computers running Linux.

	  https://github.com/adafruit/Adafruit_Blinka
```

## buildroot-overlay/package/python-adafruit-platformdetect/Config.in
```kconfig
config BR2_PACKAGE_PYTHON_ADAFRUIT_PLATFORMDETECT
	bool "python-adafruit-platformdetect"
	select BR2_PACKAGE_PYTHON3
	help
	  Adafruit Python library for detecting what platform a
	  Python script is running on.

	  https://github.com/adafruit/Adafruit_Python_PlatformDetect
```

## buildroot-overlay/package/python-adafruit-pureio/Config.in
```kconfig
config BR2_PACKAGE_PYTHON_ADAFRUIT_PUREIO
	bool "python-adafruit-pureio"
	select BR2_PACKAGE_PYTHON3
	help
	  Adafruit PureIO provides pure Python file I/O operations
	  with no external dependencies.

	  https://github.com/adafruit/Adafruit_Python_PureIO
```

## buildroot-overlay/package/python-k230/Config.in
```kconfig
config BR2_PACKAGE_PYTHON_K230
    tristate "python-k230"
    select BR2_PACKAGE_PYTHON3
    select BR2_PACKAGE_PYTHON_PYBIND if BR2_INSTALL_LIBSTDCPP
    select BR2_PACKAGE_LVGL
    select BR2_PACKAGE_LIBNNCASE
    select BR2_PACKAGE_LIBMMZ
    select BR2_PACKAGE_GSL_LITE
    select BR2_PACKAGE_JSON_FOR_MODERN_CPP
    help
        Python test for k230
```

## buildroot-overlay/package/usage_ai2d/Config.in
```kconfig
config BR2_PACKAGE_USAGE_AI2D
    bool "usage_ai2d"
    select BR2_PACKAGE_GSL_LITE
    select BR2_PACKAGE_OPENCV4
    select BR2_PACKAGE_LIBMMZ
    help
         ai2d demo
```

## buildroot-overlay/package/uvc-gadget/Config.in
```kconfig
config BR2_PACKAGE_UVC_GADGET
    bool "uvc-gadget"
    select BR2_PACKAGE_LIBV4L
    help
      USB Video Class (UVC) gadget test application.
      Now built with Meson.

      https://git.ideasonboard.org/uvc-gadget.git
      https://gitlab.freedesktop.org/camera/uvc-gadget
```

## buildroot-overlay/package/vo_init/Config.in
```kconfig
config BR2_PACKAGE_VO_INIT
    bool "vo_init"
    select BR2_PACKAGE_LIB_DISPLAY

    help
      This package provides the vo_init application, which is used to initialize
      and configure the video output (VO) subsystem on Canaan K230 devices.
      It supports various features such as setting display resolution, rotation,
      and background color.
```

## buildroot-overlay/package/vvcam/Config.in
```kconfig
source "package/vvcam/isp-media-server/Config.in"

config BR2_PACKAGE_VVCAM
    bool "K230 ISP server"
    select BR2_PACKAGE_MXML
    select BR2_PACKAGE_LIBMICROHTTPD
    select BR2_PACKAGE_DISPLAY
    select BR2_PACKAGE_ANDROID_TOOLS
    select BR2_PACKAGE_UMTPRD
    select BR2_PACKAGE_ISP_MEDIA_SERVER
    help
        K230 ISP server

config BR2_PACKAGE_VVCAM_DEF_SENSOR
    string "default sensor"
    default "ov5647"
```

## buildroot-overlay/package/vvcam/isp-media-server/Config.in
```kconfig
config BR2_PACKAGE_ISP_MEDIA_SERVER
	bool
	help
	  K230 ISP media server prebuilt binary.
```

## buildroot-overlay/package/webrtc/Config.in
```kconfig
config BR2_PACKAGE_WEBRTC
    bool "webrtc (libpeer)"
    depends on BR2_INSTALL_LIBSTDCPP
    depends on BR2_TOOLCHAIN_HAS_THREADS
    help
        WebRTC library based on libpeer, providing peer connection,
        ICE, DTLS-SRTP, SCTP, and signaling functionality.

        This library bundles mbedtls, libsrtp2, usrsctp,
        coreHTTP, and coreMQTT as internal dependencies.
        cJSON is provided by the buildroot cjson package.

        https://github.com/nicbarker/libpeer
```

## buildroot-overlay/package/yolo/Config.in
```kconfig
config BR2_PACKAGE_YOLO
    bool "yolo demo"
    select BR2_PACKAGE_DISPLAY
    select BR2_PACKAGE_GSL_LITE
    select BR2_PACKAGE_OPENCV4
    select BR2_PACKAGE_LIBMMZ
    help
        YOLO inference demo
```
