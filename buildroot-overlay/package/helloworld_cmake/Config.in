## buildroot-overlay/package/helloworld_cmake/Config.in
```kconfig
config BR2_PACKAGE_HELLOWORLD_CMAKE
    bool "helloworld cmake"
    help
      A simple "Hello, World!" program built with CMake.
```

## buildroot-overlay/package/libnncase/Config.in
```kconfig
config BR2_PACKAGE_LIBNNCASE
    bool "nncase runtime"
    help
        nncase runtime
```

## buildroot-overlay/package/librtsp_server/Config.in
```kconfig
config BR2_PACKAGE_LIB_RTSPSERVER
    bool "RTSP Server Library"
    depends on BR2_PACKAGE_LIVE555
    help
        This option enables the RTSP Server Library, which provides functionality for streaming media over the RTSP protocol. It depends on the LIVE555 library.
```
