## buildroot-overlay/package/librtsp_client/Config.in
```kconfig
config BR2_PACKAGE_LIBRTSP_CLIENT
    bool "RTSP Client Library"
    depends on BR2_PACKAGE_LIVE555
    help
        This option enables the RTSP Client Library, which pulls H.264/H.265
        video and G.711 audio from an RTSP server and hands it to the
        application through callbacks.  It can also talk back over an ONVIF
        audio back channel.  It depends on the LIVE555 library.

        Note: unlike BR2_PACKAGE_LIB_RTSPSERVER next door, this symbol is
        named the way buildroot derives it from the directory name, so
        setting it in a defconfig is enough to build the library on its own.
```

## buildroot-overlay/package/libvcodec/Config.in
```kconfig
config BR2_PACKAGE_LIBVCODEC
	bool "libvcodec (K230 VPU 编解码封装库)"
	help
	  K230 VPU（ARM Linlon/MVX）编解码封装库。

	  把 V4L2 M2M 的 OUTPUT/CAPTURE 方向、drain 收尾、
	  SOURCE_CHANGE 事件、dmabuf 导入这些细节包起来，
	  对外只给 kd_enc_* / kd_dec_* / kd_bufgroup_* 三组接口。

	  纯 C、零第三方依赖，支持摄像头 → 编码器、
	  解码器 → DRM 显示两个方向的零拷贝。
```

## buildroot-overlay/package/rtl8189fs_vendor/Config.in
```kconfig
config BR2_PACKAGE_RTL8189FS_VENDOR
	bool "rtl8189fs (vendor)"
	depends on !BR2_s390x
	depends on BR2_LINUX_KERNEL
	depends on !BR2_PACKAGE_RTL8189FS
	depends on !BR2_PACKAGE_RTL8733BS
	help
	  Realtek RTL8188F/RTL8189FS SDIO WiFi driver, built from the
	  official Realtek vendor source drop instead of the community
	  jwrdegoede/rtl8189ES_linux fork used by the "rtl8189fs" package.

	  Mutually exclusive with "rtl8189fs" - only one of the two can
	  be enabled at a time, since both build a module named 8189fs.ko.

comment "rtl8189fs (vendor) needs a Linux kernel to be built"
	depends on !BR2_s390x
	depends on !BR2_LINUX_KERNEL
```
