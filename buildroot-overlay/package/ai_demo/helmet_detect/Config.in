## buildroot-overlay/package/ai_demo/helmet_detect/Config.in
```kconfig
config BR2_PACKAGE_HELMET_DETECT
    bool "helmet_detect"
    select BR2_PACKAGE_GSL_LITE
    select BR2_PACKAGE_COMMON
    select BR2_PACKAGE_DISPLAY
    help
        ai demo helmet_detect
```

## buildroot-overlay/package/ai_demo/kws/Config.in
```kconfig
config BR2_PACKAGE_KWS
    bool "kws"
    select BR2_PACKAGE_GSL_LITE
    select BR2_PACKAGE_COMMON
    select BR2_PACKAGE_DISPLAY
    help
        ai demo kws
```

## buildroot-overlay/package/ai_demo/licence_det/Config.in
```kconfig
config BR2_PACKAGE_LICENCE_DET
    bool "licence_det"
    select BR2_PACKAGE_GSL_LITE
    select BR2_PACKAGE_COMMON
    select BR2_PACKAGE_DISPLAY
    help
        ai demo licence_det
```

## buildroot-overlay/package/ai_demo/licence_det_rec/Config.in
```kconfig
config BR2_PACKAGE_LICENCE_DET_REC
    bool "licence_det_rec"
    select BR2_PACKAGE_GSL_LITE
    select BR2_PACKAGE_COMMON
    select BR2_PACKAGE_DISPLAY
    help
        ai demo licence_det_rec
```

## buildroot-overlay/package/ai_demo/object_detect_yolov8n/Config.in
```kconfig
config BR2_PACKAGE_OBJECT_DETECT_YOLOV8N
    bool "object_detect_yolov8n"
    select BR2_PACKAGE_GSL_LITE
    select BR2_PACKAGE_COMMON
    select BR2_PACKAGE_DISPLAY
    help
        ai demo object_detect_yolov8n
```

## buildroot-overlay/package/ai_demo/ocr/Config.in
```kconfig
config BR2_PACKAGE_OCR
    bool "ocr"
    select BR2_PACKAGE_GSL_LITE
    select BR2_PACKAGE_COMMON
    select BR2_PACKAGE_DISPLAY
    help
        ai demo ocr
```

## buildroot-overlay/package/ai_demo/person_detect/Config.in
```kconfig
config BR2_PACKAGE_PERSON_DETECT
    bool "person_detect"
    select BR2_PACKAGE_GSL_LITE
    select BR2_PACKAGE_COMMON
    select BR2_PACKAGE_DISPLAY
    help
        ai demo person_detect
```

## buildroot-overlay/package/ai_demo/person_distance/Config.in
```kconfig
config BR2_PACKAGE_PERSON_DISTANCE
    bool "person_distance"
    select BR2_PACKAGE_GSL_LITE
    select BR2_PACKAGE_COMMON
    select BR2_PACKAGE_DISPLAY
    help
        ai demo person_distance
```

## buildroot-overlay/package/ai_demo/pose_detect/Config.in
```kconfig
config BR2_PACKAGE_POSE_DETECT
    bool "pose_detect"
    select BR2_PACKAGE_GSL_LITE
    select BR2_PACKAGE_COMMON
    select BR2_PACKAGE_DISPLAY
    help
        ai demo pose_detect
```

## buildroot-overlay/package/ai_demo/pphumanseg/Config.in
```kconfig
config BR2_PACKAGE_PPHUMANSEG
    bool "pphumanseg"
    select BR2_PACKAGE_GSL_LITE
    select BR2_PACKAGE_COMMON
    select BR2_PACKAGE_DISPLAY
    help
        ai demo pphumanseg
```

## buildroot-overlay/package/ai_demo/puzzle_game/Config.in
```kconfig
config BR2_PACKAGE_PUZZLE_GAME
    bool "puzzle_game"
    select BR2_PACKAGE_GSL_LITE
    select BR2_PACKAGE_DISPLAY
    help
        ai demo puzzle_game
```

## buildroot-overlay/package/ai_demo/segment_yolov8n/Config.in
```kconfig
config BR2_PACKAGE_SEGMENT_YOLOV8N
    bool "segment_yolov8n"
    select BR2_PACKAGE_GSL_LITE
    select BR2_PACKAGE_COMMON
    select BR2_PACKAGE_DISPLAY
    help
        ai demo segment_yolov8n
```

## buildroot-overlay/package/ai_demo/smoke_detect/Config.in
```kconfig
config BR2_PACKAGE_SMOKE_DETECT
    bool "smoke_detect"
    select BR2_PACKAGE_GSL_LITE
    select BR2_PACKAGE_COMMON
    select BR2_PACKAGE_DISPLAY
    help
        ai demo smoke_detect
```

## buildroot-overlay/package/ai_demo/space_resize/Config.in
```kconfig
config BR2_PACKAGE_SPACE_RESIZE
    bool "space_resize"
    select BR2_PACKAGE_GSL_LITE
    select BR2_PACKAGE_COMMON
    select BR2_PACKAGE_DISPLAY
    help
        ai demo space_resize
```

## buildroot-overlay/package/ai_demo/sq_hand_det/Config.in
```kconfig
config BR2_PACKAGE_SQ_HAND_DET
    bool "sq_hand_det"
    select BR2_PACKAGE_GSL_LITE
    select BR2_PACKAGE_COMMON
    select BR2_PACKAGE_DISPLAY
    help
        ai demo sq_hand_det
```

## buildroot-overlay/package/ai_demo/sq_handkp_det/Config.in
```kconfig
config BR2_PACKAGE_SQ_HANDKP_DET
    bool "sq_handkp_det"
    select BR2_PACKAGE_GSL_LITE
    select BR2_PACKAGE_COMMON
    select BR2_PACKAGE_DISPLAY
    help
        ai demo sq_handkp_det
```

## buildroot-overlay/package/ai_demo/sq_handkp_flower/Config.in
```kconfig
config BR2_PACKAGE_SQ_HANDKP_FLOWER
    bool "sq_handkp_flower"
    select BR2_PACKAGE_GSL_LITE
    select BR2_PACKAGE_COMMON
    select BR2_PACKAGE_DISPLAY
    help
        ai demo sq_handkp_flower
```

## buildroot-overlay/package/ai_demo/sq_handkp_ocr/Config.in
```kconfig
config BR2_PACKAGE_SQ_HANDKP_OCR
    bool "sq_handkp_ocr"
    select BR2_PACKAGE_GSL_LITE
    select BR2_PACKAGE_COMMON
    select BR2_PACKAGE_DISPLAY
    help
        ai demo sq_handkp_ocr
```

## buildroot-overlay/package/ai_demo/sq_handreco/Config.in
```kconfig
config BR2_PACKAGE_SQ_HANDRECO
    bool "sq_handreco"
    select BR2_PACKAGE_GSL_LITE
    select BR2_PACKAGE_COMMON
    select BR2_PACKAGE_DISPLAY
    help
        ai demo sq_handreco
```

## buildroot-overlay/package/ai_demo/traffic_light_detect/Config.in
```kconfig
config BR2_PACKAGE_TRAFFIC_LIGHT_DETECT
    bool "traffic_light_detect"
    select BR2_PACKAGE_GSL_LITE
    select BR2_PACKAGE_COMMON
    select BR2_PACKAGE_DISPLAY
    help
        ai demo traffic_light_detect
```

## buildroot-overlay/package/ai_demo/tts_zh/Config.in
```kconfig
config BR2_PACKAGE_TTS_ZH
    bool "tts_zh"
    select BR2_PACKAGE_GSL_LITE
    select BR2_PACKAGE_COMMON
    select BR2_PACKAGE_DISPLAY
    help
        ai demo tts_zh
```

## buildroot-overlay/package/ai_demo/virtual_keyboard/Config.in
```kconfig
config BR2_PACKAGE_VIRTUAL_KEYBOARD
    bool "virtual_keyboard"
    select BR2_PACKAGE_GSL_LITE
    select BR2_PACKAGE_COMMON
    select BR2_PACKAGE_DISPLAY
    help
        ai demo virtual_keyboard
```

## buildroot-overlay/package/ai_demo/yolop_lane_seg/Config.in
```kconfig
config BR2_PACKAGE_YOLOP_LANE_SEG
    bool "yolop_lane_seg"
    select BR2_PACKAGE_GSL_LITE
    select BR2_PACKAGE_COMMON
    select BR2_PACKAGE_DISPLAY
    help
        ai demo yolop_lane_seg
```

## buildroot-overlay/package/camera_webrtc_demo/Config.in
```kconfig
config BR2_PACKAGE_CAMERA_WEBRTC_DEMO
    bool "Enable Camera WebRTC Demo"
    depends on BR2_PACKAGE_WEBRTC
    depends on BR2_PACKAGE_FFMPEG
    help
      This option enables the Camera WebRTC Demo package, which provides
      a demonstration of streaming video from a camera using WebRTC
      via libpeer, with HTTP-based SDP signaling.
```

## buildroot-overlay/package/face_detect/Config.in
```kconfig
config BR2_PACKAGE_FACE_DETECT
    bool "face detect demo"
    select BR2_PACKAGE_DISPLAY
    select BR2_PACKAGE_GSL_LITE
    select BR2_PACKAGE_OPENCV4
    select BR2_PACKAGE_LIBMMZ
    help
        Face Detect demo
```
